## application_cpu/meta-rcar-whitebox/meta-aos-iccom/conf/layer.conf
```bitbake
# We have a conf and classes directory, add to BBPATH
BBPATH .= ":${LAYERDIR}"

# We have a packages directory, add to BBFILES
BBFILES += "${LAYERDIR}/recipes-*/*/*.bb \
            ${LAYERDIR}/recipes-*/*/*.bbappend"

BBFILE_COLLECTIONS += "aos-iccom"
BBFILE_PATTERN_aos-iccom := "^${LAYERDIR}/"
BBFILE_PRIORITY_aos-iccom = "8"

LAYERSERIES_COMPAT_aos-iccom = "dunfell"
```

## application_cpu/meta-rcar-whitebox/meta-dom0/conf/layer.conf
```bitbake
# We have a conf and classes directory, add to BBPATH
BBPATH .= ":${LAYERDIR}"

# We have a packages directory, add to BBFILES
BBFILES += "${LAYERDIR}/recipes-*/*/*.bb \
            ${LAYERDIR}/recipes-*/*/*.bbappend"

BBFILE_COLLECTIONS += "dom0"
BBFILE_PATTERN_dom0 := "^${LAYERDIR}/"
BBFILE_PRIORITY_dom0 = "8"

LAYERSERIES_COMPAT_dom0 = "dunfell"
```

## application_cpu/meta-rcar-whitebox/meta-domd/conf/layer.conf
```bitbake
# We have a conf and classes directory, add to BBPATH
BBPATH .= ":${LAYERDIR}"

# We have recipes-* directories, add to BBFILES
BBFILES += "${LAYERDIR}/recipes-*/*/*.bb \
	${LAYERDIR}/recipes-*/*/*.bbappend"

BBFILE_COLLECTIONS += "domd"
BBFILE_PATTERN_domd = "^${LAYERDIR}/"
BBFILE_PRIORITY_domd = "8"

LAYERSERIES_COMPAT_domd = "dunfell"
```

## application_cpu/meta-rcar-whitebox/meta-fix-master-branch-issue/conf/layer.conf
```bitbake
# We have a conf and classes directory, add to BBPATH
BBPATH .= ":${LAYERDIR}"

# We have recipes-* directories, add to BBFILES
BBFILES += "${LAYERDIR}/recipes-*/*/*.bb \
	${LAYERDIR}/recipes-*/*/*.bbappend"

BBFILE_COLLECTIONS += "fix-master-branch-issue"
BBFILE_PATTERN_fix-master-branch-issue = "^${LAYERDIR}/"
BBFILE_PRIORITY_fix-master-branch-issue = "14"

LAYERSERIES_COMPAT_fix-master-branch-issue = "dunfell"
```

## application_cpu/meta-rcar-whitebox/meta-rcar-common/conf/distro/poky-tiny-busybox.conf
```bitbake
require conf/distro/poky.conf
DISTRO = "poky-tiny-busybox"
TCLIBC = "musl"
PREFERRED_PROVIDER_virtual/kernel ?= "linux-renesas"
VIRTUAL-RUNTIME_login_manager = "busybox"
VIRTUAL-RUNTIME_dev_manager = "udev"
```

## application_cpu/meta-rcar-whitebox/meta-rcar-common/conf/layer.conf
```bitbake
# We have a conf and classes directory, add to BBPATH
BBPATH .= ":${LAYERDIR}"

# We have recipes-* directories, add to BBFILES
BBFILES += "${LAYERDIR}/recipes-*/*/*.bb \
            ${LAYERDIR}/recipes-*/*/*.bbappend"

BBFILE_COLLECTIONS += "meta-rcar-common-dev-utils"
BBFILE_PATTERN_meta-rcar-common-dev-utils = "^${LAYERDIR}/"
BBFILE_PRIORITY_meta-rcar-common-dev-utils = "5"

#LAYERDEPENDS_meta-rcar-common-dev-utils = "rcar"
LAYERSERIES_COMPAT_meta-rcar-common-dev-utils = "dunfell"

GOVERSION = "1.18%"
PREFERRED_PROVIDER_go-native = "go-native"

# NodeJS backport from latest layers
PREFERRED_VERSION_nodejs = "16.14.2"
PREFERRED_VERSION_nodejs-native = "16.14.2"
PREFERRED_VERSION_icu = "71.1"
PREFERRED_VERSION_icu-native = "71.1"
PREFERRED_VERSION_c-ares = "1.18.1"
PREFERRED_VERSION_c-ares-native = "1.18.1"
```

## application_cpu/meta-rcar-whitebox/meta-xt-iccomlayer/conf/layer.conf
```bitbake
# We have a conf and classes directory, add to BBPATH
BBPATH .= ":${LAYERDIR}"

# We have recipes-* directories, add to BBFILES
BBFILES += "${LAYERDIR}/recipes-*/*/*.bb \
	${LAYERDIR}/recipes-*/*/*.bbappend"

BBFILE_COLLECTIONS += "xt-iccomlayer"
BBFILE_PATTERN_xt-iccomlayer = "^${LAYERDIR}/"
BBFILE_PRIORITY_xt-iccomlayer = "8"

LAYERSERIES_COMPAT_xt-iccomlayer = "dunfell"
```

## meta-aos-rcar-common/meta-aos-rcar-common-domd/conf/layer.conf
```bitbake
# We have a conf and classes directory, add to BBPATH
BBPATH .= ":${LAYERDIR}"

# We have a packages directory, add to BBFILES
BBFILES += "${LAYERDIR}/recipes-*/*/*.bb \
            ${LAYERDIR}/recipes-*/*/*.bbappend"

BBFILE_COLLECTIONS += "aos-rcar-common-domd"
BBFILE_PATTERN_aos-rcar-common-domd := "^${LAYERDIR}/"
BBFILE_PRIORITY_aos-rcar-common-domd = "12"

LAYERSERIES_COMPAT_aos-rcar-common-domd = "dunfell"
```

## meta-aos-rcar-common/meta-aos-rcar-common-domx/conf/layer.conf
```bitbake
# We have a conf and classes directory, add to BBPATH
BBPATH .= ":${LAYERDIR}"

# We have a packages directory, add to BBFILES
BBFILES += "${LAYERDIR}/recipes-*/*/*.bb \
            ${LAYERDIR}/recipes-*/*/*.bbappend"

BBFILE_COLLECTIONS += "aos-rcar-common-domx"
BBFILE_PATTERN_aos-rcar-common-domx := "^${LAYERDIR}/"
BBFILE_PRIORITY_aos-rcar-common-domx = "11"

LAYERSERIES_COMPAT_aos-rcar-common-domx = "dunfell"
```

## meta-aos-rcar-gen3/meta-aos-rcar-gen3-dom0/conf/layer.conf
```bitbake
# We have a conf and classes directory, add to BBPATH
BBPATH .= ":${LAYERDIR}"

# We have a packages directory, add to BBFILES
BBFILES += "${LAYERDIR}/recipes-*/*/*.bb \
            ${LAYERDIR}/recipes-*/*/*.bbappend"

BBFILE_COLLECTIONS += "aos-rcar-gen3-dom0"
BBFILE_PATTERN_aos-rcar-gen3-dom0 := "^${LAYERDIR}/"
BBFILE_PRIORITY_aos-rcar-gen3-dom0 = "7"

LAYERSERIES_COMPAT_aos-rcar-gen3-dom0 = "dunfell"
```

## meta-aos-rcar-gen3/meta-aos-rcar-gen3-domd/conf/layer.conf
```bitbake
# We have a conf and classes directory, add to BBPATH
BBPATH .= ":${LAYERDIR}"

# We have a packages directory, add to BBFILES
BBFILES += "${LAYERDIR}/recipes-*/*/*.bb \
            ${LAYERDIR}/recipes-*/*/*.bbappend"

BBFILE_COLLECTIONS += "aos-rcar-gen3-domd"
BBFILE_PATTERN_aos-rcar-gen3-domd := "^${LAYERDIR}/"
BBFILE_PRIORITY_aos-rcar-gen3-domd = "7"

LAYERSERIES_COMPAT_aos-rcar-gen3-domd = "dunfell"
```

## meta-aos-rcar-gen3/meta-aos-rcar-gen3-domx/conf/layer.conf
```bitbake
# We have a conf and classes directory, add to BBPATH
BBPATH .= ":${LAYERDIR}"

# We have a packages directory, add to BBFILES
BBFILES += "${LAYERDIR}/recipes-*/*/*.bb \
            ${LAYERDIR}/recipes-*/*/*.bbappend"

BBFILE_COLLECTIONS += "aos-rcar-gen3-domx"
BBFILE_PATTERN_aos-rcar-gen3-domx := "^${LAYERDIR}/"
BBFILE_PRIORITY_aos-rcar-gen3-domx = "7"

LAYERSERIES_COMPAT_aos-rcar-gen3-domx = "dunfell"
```

## meta-aos-rcar-gen4/meta-aos-rcar-gen4-domu/conf/layer.conf
```bitbake
# We have a conf and classes directory, add to BBPATH
BBPATH .= ":${LAYERDIR}"

# We have a packages directory, add to BBFILES
BBFILES += "${LAYERDIR}/recipes-*/*/*.bb \
            ${LAYERDIR}/recipes-*/*/*.bbappend"

BBFILE_COLLECTIONS += "aos-rcar-gen4-domu"
BBFILE_PATTERN_aos-rcar-gen4-domu := "^${LAYERDIR}/"
BBFILE_PRIORITY_aos-rcar-gen4-domu = "6"

LAYERSERIES_COMPAT_aos-rcar-gen4-domu = "dunfell"
```

## meta-aos-rcar-gen4/meta-aos-rcar-gen4-domx/conf/layer.conf
```bitbake
# We have a conf and classes directory, add to BBPATH
BBPATH .= ":${LAYERDIR}"

# We have a packages directory, add to BBFILES
BBFILES += "${LAYERDIR}/recipes-*/*/*.bb \
           "

BBFILES_DYNAMIC += " \
    virtualization-layer:${LAYERDIR}/recipes-extended/xen/*.bbappend \
    meta-arm:${LAYERDIR}/recipes-security/optee/*.bbappend \
"

BBFILE_COLLECTIONS += "aos-rcar-gen4-domx"
BBFILE_PATTERN_aos-rcar-gen4-domx := "^${LAYERDIR}/"
BBFILE_PRIORITY_aos-rcar-gen4-domx = "6"

LAYERSERIES_COMPAT_aos-rcar-gen4-domx = "dunfell"
```

## meta-aos-rcar-gen4/meta-aos-rcar-gen4-driver-domain/conf/layer.conf
```bitbake
# We have a conf and classes directory, add to BBPATH
BBPATH .= ":${LAYERDIR}"

# We have a packages directory, add to BBFILES
BBFILES += "${LAYERDIR}/recipes-*/*/*.bb \
            ${LAYERDIR}/recipes-*/*/*.bbappend"

BBFILE_COLLECTIONS += "aos-rcar-gen4-driver-domain"
BBFILE_PATTERN_aos-rcar-gen4-driver-domain := "^${LAYERDIR}/"
BBFILE_PRIORITY_aos-rcar-gen4-driver-domain = "6"

LAYERSERIES_COMPAT_aos-rcar-gen4-driver-domain = "dunfell"
```

## meta-s4sk-support/meta-s4sk-support-dom0/conf/layer.conf
```bitbake
# We have a conf and classes directory, add to BBPATH
BBPATH .= ":${LAYERDIR}"

# We have recipes-* directories, add to BBFILES
BBFILES += "${LAYERDIR}/recipes-*/*/*.bb \
	${LAYERDIR}/recipes-*/*/*.bbappend"

BBFILE_COLLECTIONS += "s4sk-support-dom0"
BBFILE_PATTERN_s4sk-support-dom0 = "^${LAYERDIR}/"
BBFILE_PRIORITY_s4sk-support-dom0 = "18"

LAYERSERIES_COMPAT_s4sk-support-dom0 = "dunfell"
```

## meta-s4sk-support/meta-s4sk-support-domd/conf/layer.conf
```bitbake
# We have a conf and classes directory, add to BBPATH
BBPATH .= ":${LAYERDIR}"

# We have recipes-* directories, add to BBFILES
BBFILES += "${LAYERDIR}/recipes-*/*/*.bb \
	${LAYERDIR}/recipes-*/*/*.bbappend"

BBFILE_COLLECTIONS += "s4sk-support-domd"
BBFILE_PATTERN_s4sk-support-domd = "^${LAYERDIR}/"
BBFILE_PRIORITY_s4sk-support-domd = "18"

LAYERSERIES_COMPAT_s4sk-support-domd = "dunfell"
```

## meta-s4sk-support/meta-s4sk-support-driver-domain/conf/layer.conf
```bitbake
# We have a conf and classes directory, add to BBPATH
BBPATH .= ":${LAYERDIR}"

# We have recipes-* directories, add to BBFILES
BBFILES += "${LAYERDIR}/recipes-*/*/*.bb \
	${LAYERDIR}/recipes-*/*/*.bbappend"

BBFILE_COLLECTIONS += "s4sk-support-driver-domain"
BBFILE_PATTERN_s4sk-support-driver-domain = "^${LAYERDIR}/"
BBFILE_PRIORITY_s4sk-support-driver-domain = "18"

LAYERSERIES_COMPAT_s4sk-support-driver-domain = "dunfell"
```

## meta-spider-support/meta-spider-support-dom0/conf/layer.conf
```bitbake
# We have a conf and classes directory, add to BBPATH
BBPATH .= ":${LAYERDIR}"

# We have recipes-* directories, add to BBFILES
BBFILES += "${LAYERDIR}/recipes-*/*/*.bb \
	${LAYERDIR}/recipes-*/*/*.bbappend"

BBFILE_COLLECTIONS += "spider-support-dom0"
BBFILE_PATTERN_spider-support-dom0 = "^${LAYERDIR}/"
BBFILE_PRIORITY_spider-support-dom0 = "18"

LAYERSERIES_COMPAT_spider-support-dom0 = "dunfell"
```

## meta-spider-support/meta-spider-support-domd/conf/layer.conf
```bitbake
# We have a conf and classes directory, add to BBPATH
BBPATH .= ":${LAYERDIR}"

# We have recipes-* directories, add to BBFILES
BBFILES += "${LAYERDIR}/recipes-*/*/*.bb \
	${LAYERDIR}/recipes-*/*/*.bbappend"

BBFILE_COLLECTIONS += "spider-support-domd"
BBFILE_PATTERN_spider-support-domd = "^${LAYERDIR}/"
BBFILE_PRIORITY_spider-support-domd = "18"

LAYERSERIES_COMPAT_spider-support-domd = "dunfell"
```

## meta-whitebox-demo/conf/layer.conf
```bitbake
# We have a conf and classes directory, add to BBPATH
BBPATH .= ":${LAYERDIR}"

# We have recipes-* directories, add to BBFILES
BBFILES += "${LAYERDIR}/recipes-*/*/*.bb \
            ${LAYERDIR}/recipes-*/*/*.bbappend"

BBFILE_COLLECTIONS += "meta-rcar-whitebox-demo"
BBFILE_PATTERN_meta-rcar-whitebox-demo = "^${LAYERDIR}/"
BBFILE_PRIORITY_meta-rcar-whitebox-demo = "15"

LAYERSERIES_COMPAT_meta-rcar-whitebox-demo = "dunfell"
```
